## OpenGear-ACM500x-4.1.1u2-devkit-20180508/linux-3.x/drivers/i2c/chips/Kconfig
```kconfig
#
# Miscellaneous I2C chip drivers configuration
#
# *** DEPRECATED! Do not add new entries! See Makefile ***
#

menu "Miscellaneous I2C Chip support"

config SENSORS_PCA9534
	tristate "NXP PCA9534 I2C I/O expander"
	depends on I2C
	help
	  If you say yes here you get support for the PCA9534 chip.

	  This driver can also be built as a module.  If so, the module
	  will be called pca9534.

endmenu
```

## OpenGear-ACM500x-4.1.1u2-devkit-20180508/modules/GobiNet/Kconfig
```kconfig
menu "Gobi WWAN Drivers"

config MODULES_GOBINET
  	tristate "GobiNet"
	---help---
	Gobi Network USB driver. Needed for MC77xx in QMI mode

endmenu
```

## OpenGear-ACM500x-4.1.1u2-devkit-20180508/modules/GobiSerial/Kconfig
```kconfig
menu "Gobi Serial Drivers"

config MODULES_GOBISERIAL
  	tristate "GobiSerial"
	---help---
	Gobi Serial USB driver. Needed for MC77xx in QMI mode

endmenu
```

## OpenGear-ACM500x-4.1.1u2-devkit-20180508/modules/Kconfig
```kconfig
#
# external module configuration (disabled for now)
# davidm@snapgear.com
#

mainmenu "Module Configuration"

config MODULES
	bool
	default y

source ralink/Kconfig
source asix/Kconfig
source kszfeat/Kconfig
source GobiNet/Kconfig
source GobiSerial/Kconfig
source ocf/Kconfig

#source mymodule/Kconfig
```

## OpenGear-ACM500x-4.1.1u2-devkit-20180508/modules/asix/Kconfig
```kconfig
menu "Asix USB Network Drivers"

config MODULES_ASIX_AX88172A
  	tristate "ax88172a"
	---help---
	  Vendor driver for the ASIX AX88172A. This is tailored
	  specifically for the OpenGear IM4216-34 where it is in
	  configured in MAC mode with an external MII interface to
	  an realtek RTL8309 PHY.

endmenu
```

## OpenGear-ACM500x-4.1.1u2-devkit-20180508/modules/kszfeat/Kconfig
```kconfig
menu "FSZ8692 Feature reg control"

config MODULES_KSZFEAT
  	tristate "kszfeat"
	---help---
	  Vendor driver for hacking the ksz8692 feature register.

endmenu
```

## OpenGear-ACM500x-4.1.1u2-devkit-20180508/modules/ralink/Kconfig
```kconfig
menu "RaLink Drivers"

config MODULES_RALINK_RT2860
  	tristate "rt2860"

endmenu
```
